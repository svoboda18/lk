
&NR_RNKS=2

;D.S SD:0x10203000 %LE %LONG 0x00025002; EMI_CONA
D.S SD:0x10203000 %LE %LONG 0x00025352; EMI_CONA dual rank 512M
;D.S SD:0x10203000 %LE %LONG 0x00005352; EMI_CONA single rank 512M
;D.S SD:0x10203000 %LE %LONG 0x50045052; EMI_CONA , single channel/single rank

D.S SD:0x100041EC %LE %LONG 0x00101001;
D.S SD:0x1000F1EC %LE %LONG 0x00101001;

D.S SD:0x1000407c %LE %LONG 0xC0063201;
D.S SD:0x1000F07c %LE %LONG 0xC0063201;

D.S SD:0x10004430 %LE %LONG 0x10ff10ff;
D.S SD:0x1000F430 %LE %LONG 0x10ff10ff;

D.S SD:0x10004434 %LE %LONG 0xffffffff;
D.S SD:0x1000F434 %LE %LONG 0xffffffff;

D.S SD:0x10004438 %LE %LONG 0xffffffff;
D.S SD:0x1000F438 %LE %LONG 0xffffffff;

D.S SD:0x1000443c %LE %LONG 0x0000001f;
D.S SD:0x1000F43c %LE %LONG 0x0000001f;

D.S SD:0x10004400 %LE %LONG 0x00000000;
D.S SD:0x1000F400 %LE %LONG 0x00000000;

D.S SD:0x10004404 %LE %LONG 0x00302000;
D.S SD:0x1000F404 %LE %LONG 0x00302000;

;D.S SD:0x10004418 %LE %LONG 0x00000228;
;D.S SD:0x1000F418 %LE %LONG 0x00000228;
D.S SD:0x10004418 %LE %LONG 0x00000322;
D.S SD:0x1000F418 %LE %LONG 0x00000322;

D.S SD:0x10004408 %LE %LONG 0x00000000;
D.S SD:0x1000F408 %LE %LONG 0x00000000;

D.S SD:0x1000440C %LE %LONG 0x00000000;
D.S SD:0x1000F40C %LE %LONG 0x00000000;

D.S SD:0x10004410 %LE %LONG 0x00955555;
D.S SD:0x1000F410 %LE %LONG 0x00955555;

D.S SD:0x1000441C %LE %LONG 0x11111111;
D.S SD:0x1000F41C %LE %LONG 0x11111111;

D.S SD:0x10004420 %LE %LONG 0x11111111;
D.S SD:0x1000F420 %LE %LONG 0x11111111;

D.S SD:0x10004424 %LE %LONG 0x11111111;
D.S SD:0x1000F424 %LE %LONG 0x11111111;

D.S SD:0x10004428 %LE %LONG 0x0000ffff;
D.S SD:0x1000F428 %LE %LONG 0x0000ffff;

D.S SD:0x1000442C %LE %LONG 0x000000ff;
D.S SD:0x1000F42C %LE %LONG 0x000000ff;

D.S SD:0x100041E0 %LE %LONG 0x3601ffff;
D.S SD:0x1000F1E0 %LE %LONG 0x3601ffff;

D.S SD:0x100041F8 %LE %LONG 0x0c002ec1;
D.S SD:0x1000F1F8 %LE %LONG 0x0c002ec1;

D.S SD:0x1000423C %LE %LONG 0x2201ffff;
D.S SD:0x1000F23C %LE %LONG 0x2201ffff;

D.S SD:0x10004008 %LE %LONG 0x00406300;
D.S SD:0x1000F008 %LE %LONG 0x00406300;

D.S SD:0x10004048 %LE %LONG 0x2200110d;
D.S SD:0x1000F048 %LE %LONG 0x2200110d;

D.S SD:0x1000408C %LE %LONG 0x00000001;
D.S SD:0x1000F08C %LE %LONG 0x00000001;

;pinmux
D.S SD:0x100040D8 %LE %LONG 0x00500510;
D.S SD:0x1000F0D8 %LE %LONG 0x00500510;

D.S SD:0x100040E4 %LE %LONG 0x00002111;
D.S SD:0x1000F0E4 %LE %LONG 0x00002111;

D.S SD:0x100040B8 %LE %LONG 0x99169952;
D.S SD:0x1000F0B8 %LE %LONG 0x99169952;

D.S SD:0x100040BC %LE %LONG 0x99109950;
D.S SD:0x1000F0BC %LE %LONG 0x99109950;

D.S SD:0x10004090 %LE %LONG 0x00000000;
D.S SD:0x1000F090 %LE %LONG 0x00000000;

D.S SD:0x10004094 %LE %LONG 0x80000000;
D.S SD:0x1000F094 %LE %LONG 0x80000000;

 D.S SD:0x10004098 %LE %LONG 0x80000000;
 D.S SD:0x1000F098 %LE %LONG 0x80000000;

D.S SD:0x100040DC %LE %LONG 0x83200200;
D.S SD:0x1000F0DC %LE %LONG 0x83200200;

D.S SD:0x100040E0 %LE %LONG 0x12200200;
D.S SD:0x1000F0E0 %LE %LONG 0x12200200;

D.S SD:0x10004118 %LE %LONG 0x00000002;
D.S SD:0x1000F118 %LE %LONG 0x00000002;

D.S SD:0x100040F0 %LE %LONG 0x00000000;
D.S SD:0x1000F0F0 %LE %LONG 0x00000000;

D.S SD:0x100040F4 %LE %LONG 0x11000000;
D.S SD:0x1000F0F4 %LE %LONG 0x11000000;

D.S SD:0x10004168 %LE %LONG 0x00007080;  //R_DMPENDREFCNT
D.S SD:0x1000F168 %LE %LONG 0x00007080;

D.S SD:0x10004130 %LE %LONG 0x30000000;
D.S SD:0x1000F130 %LE %LONG 0x30000000;

;pinmux
D.S SD:0x100040D8 %LE %LONG 0x00700510;
D.S SD:0x1000F0D8 %LE %LONG 0x00700510;

D.S SD:0x10004004 %LE %LONG 0xf00485a3;
D.S SD:0x1000F004 %LE %LONG 0xf00485a3;

D.S SD:0x10004124 %LE %LONG 0xc0000000;
D.S SD:0x1000F124 %LE %LONG 0xc0000000;

D.S SD:0x10004138 %LE %LONG 0x00000000;
D.S SD:0x1000F138 %LE %LONG 0x00000000;

D.S SD:0x10004094 %LE %LONG 0x40404040;
D.S SD:0x1000F094 %LE %LONG 0x40404040;

D.S SD:0x10004098 %LE %LONG 0x40404040;
D.S SD:0x1000F098 %LE %LONG 0x40404040;

D.S SD:0x100041C0 %LE %LONG 0x8000c8b8;
D.S SD:0x1000F1C0 %LE %LONG 0x8000c8b8;

D.S SD:0x100040fc %LE %LONG 0x07000000;
D.S SD:0x1000F0fc %LE %LONG 0x07000000;

D.S SD:0x100041f8 %LE %LONG 0x0c002ec1;
D.S SD:0x1000F1f8 %LE %LONG 0x0c002ec1;

D.S SD:0x100041ec %LE %LONG 0x00100001;
D.S SD:0x1000F1ec %LE %LONG 0x00100001;

D.S SD:0x1000407c %LE %LONG 0xc0063201;
D.S SD:0x1000F07c %LE %LONG 0xc0063201;

D.S SD:0x10004028 %LE %LONG 0xf1200f01;
D.S SD:0x1000F028 %LE %LONG 0xf1200f01;

D.S SD:0x10004158 %LE %LONG 0x00000000;
D.S SD:0x1000F158 %LE %LONG 0x00000000;

D.S SD:0x100040e4 %LE %LONG 0x00000015;
D.S SD:0x1000F0e4 %LE %LONG 0x00000015;

D.S SD:0x10004110 %LE %LONG 0x03251193;
D.S SD:0x1000F110 %LE %LONG 0x03251193;

D.S SD:0x100040e4 %LE %LONG 0x00000011;
D.S SD:0x1000F0e4 %LE %LONG 0x00000011;

D.S SD:0x100041ec %LE %LONG 0x00000001;
D.S SD:0x1000F1ec %LE %LONG 0x00000001;

D.S SD:0x10004084 %LE %LONG 0x00000a56;
D.S SD:0x1000F084 %LE %LONG 0x00000a56;

D.S SD:0x10004080 %LE %LONG 0x00060600;
D.S SD:0x1000F080 %LE %LONG 0x00060600;

D.S SD:0x1000400c %LE %LONG 0x00000000;
D.S SD:0x1000F00c %LE %LONG 0x00000000;

D.S SD:0x10004000 %LE %LONG 0x555844a3;
D.S SD:0x1000F000 %LE %LONG 0x555844a3;

D.S SD:0x10004044 %LE %LONG 0xa80d0400;
D.S SD:0x1000F044 %LE %LONG 0xa80d0400;

D.S SD:0x100041e8 %LE %LONG 0x81000d20;
D.S SD:0x1000F1e8 %LE %LONG 0x81000d20;

D.S SD:0x10004008 %LE %LONG 0x00406360;  //R_DMREFCNT
D.S SD:0x1000F008 %LE %LONG 0x00406360;



D.S SD:0x10004010 %LE %LONG 0x00000000;
D.S SD:0x1000F010 %LE %LONG 0x00000000;

D.S SD:0x10004100 %LE %LONG 0x01008110;
D.S SD:0x1000F100 %LE %LONG 0x01008110;

D.S SD:0x1000401c %LE %LONG 0x12121212;
D.S SD:0x1000F01c %LE %LONG 0x12121212;

D.S SD:0x100040f8 %LE %LONG 0x00000000;
D.S SD:0x1000F0f8 %LE %LONG 0x00000000;

D.S SD:0x100040fc %LE %LONG 0x07000000;
D.S SD:0x1000F0fc %LE %LONG 0x07000000;

D.S SD:0x100041dc %LE %LONG 0xd2623840;
D.S SD:0x1000F1dc %LE %LONG 0xd2623840;

D.S SD:0x100040C4 %LE %LONG 0x00000000;  //R_DMREFDIS
D.S SD:0x1000F0C4 %LE %LONG 0x00000000;

D.S SD:0x100041ec %LE %LONG 0x00100001;
D.S SD:0x1000F1ec %LE %LONG 0x00100001;

;wait 1.ms
D.S SD:0x10004088 %LE %LONG 0x0000003F;
D.S SD:0x100041E4 %LE %LONG 0x00000001;
D.S SD:0x100041E4 %LE %LONG 0x00000000;
D.S SD:0x100041E4 %LE %LONG 0x00000000;
D.S SD:0x100041E4 %LE %LONG 0x00000000;
D.S SD:0x100041E4 %LE %LONG 0x00000000;
D.S SD:0x100041E4 %LE %LONG 0x00000000;
D.S SD:0x100041E4 %LE %LONG 0x00000000;
D.S SD:0x100041E4 %LE %LONG 0x00000000;
D.S SD:0x100041E4 %LE %LONG 0x00000000;
D.S SD:0x100041E4 %LE %LONG 0x00000000;
D.S SD:0x100041E4 %LE %LONG 0x00000000;

;wait 1.ms
D.S SD:0x10004088 %LE %LONG 0x00FF000A;
D.S SD:0x100041E4 %LE %LONG 0x00000001;
D.S SD:0x100041E4 %LE %LONG 0x00000000;
D.S SD:0x100041E4 %LE %LONG 0x00000000;
D.S SD:0x100041E4 %LE %LONG 0x00000000;
D.S SD:0x100041E4 %LE %LONG 0x00000000;
D.S SD:0x100041E4 %LE %LONG 0x00000000;
D.S SD:0x100041E4 %LE %LONG 0x00000000;
D.S SD:0x100041E4 %LE %LONG 0x00000000;
D.S SD:0x100041E4 %LE %LONG 0x00000000;
D.S SD:0x100041E4 %LE %LONG 0x00000000;
D.S SD:0x100041E4 %LE %LONG 0x00000000;

;wait 1.ms
D.S SD:0x10004088 %LE %LONG 0x00330001;
D.S SD:0x100041E4 %LE %LONG 0x00000001;
D.S SD:0x100041E4 %LE %LONG 0x00000000;
D.S SD:0x100041E4 %LE %LONG 0x00000000;
D.S SD:0x100041E4 %LE %LONG 0x00000000;
D.S SD:0x100041E4 %LE %LONG 0x00000000;
D.S SD:0x100041E4 %LE %LONG 0x00000000;
D.S SD:0x100041E4 %LE %LONG 0x00000000;
D.S SD:0x100041E4 %LE %LONG 0x00000000;
D.S SD:0x100041E4 %LE %LONG 0x00000000;
D.S SD:0x100041E4 %LE %LONG 0x00000000;
D.S SD:0x100041E4 %LE %LONG 0x00000000;

;wait 1.ms
D.S SD:0x10004088 %LE %LONG 0x00060002;
D.S SD:0x100041E4 %LE %LONG 0x00000001;
D.S SD:0x100041E4 %LE %LONG 0x00001100;
D.S SD:0x100041E4 %LE %LONG 0x00000000;
D.S SD:0x100041E4 %LE %LONG 0x00000000;
D.S SD:0x100041E4 %LE %LONG 0x00000000;
D.S SD:0x100041E4 %LE %LONG 0x00000000;
D.S SD:0x100041E4 %LE %LONG 0x00000000;
D.S SD:0x100041E4 %LE %LONG 0x00000000;
D.S SD:0x100041E4 %LE %LONG 0x00000000;
D.S SD:0x100041E4 %LE %LONG 0x00000000;
D.S SD:0x100041E4 %LE %LONG 0x00000000;

D.S SD:0x10203060 %LE %LONG 0x00000400; Enable EMI
